## conf/layer.conf
```bitbake
# We have a conf and classes directory, add to BBPATH 
BBPATH := "${BBPATH}:${LAYERDIR}" 

# We have a packages directory, add to BBFILES 
BBFILES := "${BBFILES} ${LAYERDIR}/recipes-*/*/*.bb ${LAYERDIR}/recipes-*/*/*.bbappend" 

# Adding recipes for added components
BBFILE_COLLECTIONS += "components" 
BBFILE_PATTERN_components := "^${LAYERDIR}/" 
BBFILE_PRIORITY_components := "5"

# Adding recipes for modified components
BBFILE_COLLECTIONS += "modifications" 
BBFILE_PATTERN_modifications := "^${LAYERDIR}/" 
BBFILE_PRIORITY_modifications := "5"

# custom license locations
LICENSE_PATH += "${LAYERDIR}/licenses"
```
